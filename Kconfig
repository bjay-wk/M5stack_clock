## Kconfig
```kconfig
menu "CLOCK Configuration"

config CONFIG_CLOCK_BRIGHTNESS_AUTO
    bool "Automatic Brightness ajustment with an Ambient Light Sensor"
    default y

config CONFIG_CLOCK_BRIGHTNESS_DEFAULT_VALUE
	int "default brightness value [1-255]"
	default 100
	help
    [1-255]
```

## components/esp32-ipgeolocation_io/Kconfig
```kconfig
menu "Ip Geolocation Io"

config IP_GEOLOCATION_IO_API_KEY
    string "api key"
    default "apikey"
	help
	api key

endmenu
```

## lib/esp32-open-meteo/Kconfig
```kconfig
menu "OpenMeteo"

config OPEN_METEO_API_KEY
    string "api key"
    default "apikey"
	help
	api key

endmenu
```

## src/Kconfig
```kconfig
menu "CLOCK Configuration"

config CLOCK_BRIGHTNESS_AUTO
    bool "Automatic Brightness ajustment with an Ambient Light Sensor"
    default y

config CLOCK_BRIGHTNESS_DEFAULT_VALUE
	int "default brightness value [1-255]"
	default 100
	help
    [1-255]

endmenu
```
